## config/boards/shields/doe/Kconfig.defconfig
```kconfig
if SHIELD_DOE_LEFT

    config ZMK_KEYBOARD_NAME
        default "doe"

    config ZMK_SPLIT_BLE_ROLE_CENTRAL
        default y
endif

if SHIELD_DOE_RIGHT

    config ZMK_KEYBOARD_NAME
        default "Doe Right"

endif

if SHIELD_DOE_LEFT || SHIELD_DOE_RIGHT

    config ZMK_SPLIT
        default y

    if ZMK_DISPLAY
    
    config I2C
        default y
    
    config SSD1306
        default y
    
    endif # ZMK_DISPLAY

    if LVGL
    
    if ZMK_RGB_UNDERGLOW
    
    config WS2812_STRIP
        default y
    endif

endif
```

## config/boards/shields/doe/Kconfig.shield
```kconfig
config SHIELD_DOE_LEFT
    def_bool $(shields_list_contains,doe_left)

config SHIELD_DOE_RIGHT
    def_bool $(shields_list_contains,doe_right)
```
